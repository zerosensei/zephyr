## dts/bindings/watchdog/wch,ch32-watchdog.yaml
```yaml
description: CH32 watchdog

compatible: "wch,ch32-watchdog"

include: base.yaml

properties:
    reg:
      required: true

    label:
      required: true
```

## dts/bindings/watchdog/wch,ch32-window-watchdog.yaml
```yaml
description: CH32 system window watchdog

compatible: "wch,ch32-window-watchdog"

include: base.yaml

properties:
    reg:
      required: true

    label:
      required: true

    clocks:
      required: true
```

## modules/Kconfig.ch32
```kconfig
# CH32 devices HAL config

# Copyright (c) 2016 Linaro Limited.
# SPDX-License-Identifier: Apache-2.0


config HAS_CH32_DRIVERS
	bool
	# depends on SOC_FAMILY_CH32

if HAS_CH32_DRIVERS

config USE_CH32_HAL_GPIO
	bool
	help
	  Enable CH32Cube General-purpose I/Os (GPIO) HAL module driver

endif
```

## modules/Kconfig.wch
```kconfig
# Copyright (c) 2024 zerosensei
# SPDX-License-Identifier: Apache-2.0

config HAS_CH58X_HAL
    bool
    depends on SOC_FAMILY_WCH
```

## soc/riscv/ch32/Kconfig
```kconfig
config SOC_FAMILY_CH32
    bool
    select BUILD_OUTPUT_HEX

if SOC_FAMILY_CH32

config SOC_FAMILY
	string
	default "ch32"

source "soc/riscv/ch32/*/Kconfig.soc"

endif # SOC_FAMILY_CH32
```

## soc/riscv/ch32/ch32v/Kconfig.series
```kconfig
# Copyright (c) 2021 Nanjing Qinheng Microelectronics Co., Ltd.
# SPDX-License-Identifier: Apache-2.0

config SOC_SERIES_CH32V
	bool "CH32V Series MCU"
	select RISCV
	select RISCV_GP
	select SOC_FAMILY_CH32
	select DYNAMIC_INTERRUPTS
	select CLOCK_CONTROL
	select HAS_CH32_DRIVERS

	help
		Enable support for CH32V MCU series
```

## soc/riscv/ch32v307/Kconfig.defconfig
```kconfig
# Copyright (c) 2021 Nanjing Qinheng Microelectronics Co., Ltd.
# SPDX-License-Identifier: Apache-2.0

if SOC_CH32V307

config SOC
	default "ch32v307"

config NUM_IRQS
	default 104

endif 
```

## soc/riscv/ch32v307/Kconfig.soc
```kconfig
# Copyright (c) 2021 Nanjing Qinheng Microelectronics Co., Ltd.
# SPDX-License-Identifier: Apache-2.0

config SOC_CH32V307
	bool "CH32V307"
	select RISCV
	select RISCV_GP
	select DYNAMIC_INTERRUPTS
	select CLOCK_CONTROL
```

## soc/riscv/riscv-privilege/ch32v/Kconfig.defconfig.ch32v307_vct6
```kconfig
# ST STM32F401CC MCU configuration options

# Copyright (c) 2019 Linumiz
# SPDX-License-Identifier: Apache-2.0

if SOC_CH32V307_VCT6

config SOC
	default	"ch32v307_vct6"

config NUM_IRQS
	default 100

endif # SOC_CH32V307_VCT6
```

## soc/riscv/riscv-privilege/ch32v/Kconfig.defconfig.series
```kconfig
# Copyright (c) 2021 Nanjing Qinheng Microelectronics Co., Ltd.
# SPDX-License-Identifier: Apache-2.0

if SOC_SERIES_CH32V

source "soc/riscv/riscv-privilege/ch32v/Kconfig.defconfig.ch32v*"

config SOC_SERIES
	default "ch32v"

config CLOCK_CONTROL
	default y

config UART_CH32
	default y
	depends on SERIAL

if GPIO
config GPIO_CH32
	default y

endif # GPIO

config PINMUX_CH32
	default y
	depends on PINMUX

endif # SOC_SERIES_CH32V
```

## soc/riscv/riscv-privilege/ch32v/Kconfig.series
```kconfig
# Copyright (c) 2021 Nanjing Qinheng Microelectronics Co., Ltd.
# SPDX-License-Identifier: Apache-2.0

config SOC_SERIES_CH32V
	bool "CH32V Series MCU"
	select RISCV
	select RISCV_GP
	# select SOC_FAMILY_CH32
	select SOC_FAMILY_RISCV_PRIVILEGE
	# select COMPRESSED_ISA
	select CLOCK_CONTROL_CH32 if CLOCK_CONTROL
	select INCLUDE_RESET_VECTOR
	select BUILD_OUTPUT_HEX

	select DYNAMIC_INTERRUPTS
	select CLOCK_CONTROL
	select HAS_CH32_DRIVERS

	help
		Enable support for CH32V MCU series
```

## soc/riscv/riscv-privilege/ch32v30x/Kconfig.defconfig.series
```kconfig
# Copyright (c) 2021 Nanjing Qinheng Microelectronics Co., Ltd.
# SPDX-License-Identifier: Apache-2.0

if SOC_SERIES_CH32V30X

source "soc/riscv/riscv-privilege/ch32v30X/Kconfig.defconfig.ch32v30*"

config SOC_SERIES
	default "ch32v30x"

# config CLOCK_CONTROL
# 	default y

# config UART_CH32
# 	default y
# 	depends on SERIAL

# if GPIO
# config GPIO_CH32
# 	default y

# endif # GPIO

# config PINMUX_CH32
# 	default y
# 	depends on PINMUX

endif # SOC_SERIES_CH32V30X
```

## soc/riscv/riscv-privilege/ch32v30x/Kconfig.series
```kconfig
# Copyright (c) 2021 Nanjing Qinheng Microelectronics Co., Ltd.
# SPDX-License-Identifier: Apache-2.0

config SOC_SERIES_CH32V30X
	bool "CH32V30X Series MCU"
	select RISCV
	select SOC_FAMILY_RISCV_PRIVILEGE
	select INCLUDE_RESET_VECTOR
	select BUILD_OUTPUT_HEX

	# select DYNAMIC_INTERRUPTS
	select HAS_CH32V30X_HAL

	help
		Enable support for CH32V30X MCU series
```

## soc/riscv/riscv-privilege/ch32v30x/Kconfig.soc
```kconfig
# Copyright (c) 2021 Nanjing Qinheng Microelectronics Co., Ltd.
# SPDX-License-Identifier: Apache-2.0

config SOC_CH32V307
	depends on SOC_SERIES_CH32V30X
	bool
	select CPU_HAS_FPU

config SOC_CH32V305
	depends on SOC_SERIES_CH32V30X
	bool
	select CPU_HAS_FPU

config SOC_CH32V303
	depends on SOC_SERIES_CH32V30X
	bool
	select CPU_HAS_FPU

config SOC_CH32V208
	depends on SOC_SERIES_CH32V30X
	bool

config SOC_CH32V203
	depends on SOC_SERIES_CH32V30X
	bool

choice 
	prompt "CH32V30x MCU Selection"
	depends on SOC_SERIES_CH32V30X

config SOC_CH32V307_VCT6
	bool "CH32V307_VCT6"
	select SOC_CH32V307

config SOC_CH32V307_RCT6
	bool "CH32V307_RCT6"
	select SOC_CH32V307

config SOC_CH32V307_WCU6
	bool "CH32V307_VCT6"
	select SOC_CH32V307

config SOC_CH32V305_FBP6
	bool "CH32V305_FBP6"
	select SOC_CH32V305

config SOC_CH32V305_RBT6
	bool "CH32V307_RBT6"
	select SOC_CH32V305

config SOC_CH32V305_RBT6
	bool "CH32V307_RBT6"
	select SOC_CH32V305

config SOC_CH32V303_VCT6
	bool "CH32V303_VCT6"
	select SOC_CH32V303

config SOC_CH32V303_RCT6
	bool "CH32V303_RCT6"
	select SOC_CH32V303

config SOC_CH32V303_RBT6
	bool "CH32V303_RBT6"
	select SOC_CH32V303

config SOC_CH32V303_CBT6
	bool "CH32V303_CBT6"
	select SOC_CH32V303

config SOC_CH32V208_GBU6
	bool "CH32V208_GBU6"
	select SOC_CH32V208

config SOC_CH32V208_CBU6
	bool "CH32V208_CBU6"
	select SOC_CH32V208

config SOC_CH32V208_RBT6
	bool "CH32V208_RBT6"
	select SOC_CH32V208

config SOC_CH32V208_WBU6
	bool "CH32V208_WBU6"
	select SOC_CH32V208

config SOC_CH32V203_F6P6
	bool "CH32V203_F6P6"
	select SOC_CH32V203

config SOC_CH32V203_G6P6
	bool "CH32V203_G6P6"
	select SOC_CH32V203

config SOC_CH32V203_K6T6
	bool "CH32V203_K6T6"
	select SOC_CH32V203

config SOC_CH32V203_K8T6
	bool "CH32V203_K8T6"
	select SOC_CH32V203

config SOC_CH32V203_C6T6
	bool "CH32V203_C6T6"
	select SOC_CH32V203

config SOC_CH32V203_C8T6
	bool "CH32V203_C8T6"
	select SOC_CH32V203

config SOC_CH32V203_C8U6
	bool "CH32V203_C8U6"
	select SOC_CH32V203

config SOC_CH32V203_RBT6
	bool "CH32V203_RBT6"
	select SOC_CH32V203

endchoice
```

## soc/riscv/riscv-privilege/wch/Kconfig.defconfig.ch583
```kconfig
# Copyright (c) 2023 zerosensei
# SPDX-License-Identifier: Apache-2.0

if SOC_CH583M

config SOC
    default "CH583M"

config NUM_IRQS
	default 28

endif # SOC_CH583
```

## soc/riscv/riscv-privilege/wch/Kconfig.defconfig.series
```kconfig
# Copyright (c) 2023 zerosensei
# SPDX-License-Identifier: Apache-2.0

if SOC_SERIES_CH58X

source "soc/riscv/riscv-privilege/wch/Kconfig.defconfig.ch58*"

config SOC_SERIES
    default "ch58"

endif # SOC_SERIES_CH58X
```

## soc/riscv/riscv-privilege/wch/Kconfig.series
```kconfig
# Copyright (c) 2023 zerosensei
# SPDX-License-Identifier: Apache-2.0

config SOC_SERIES_CH58X
    bool "WCH CH58x series SoC implementation"
    select RISCV
    select SOC_FAMILY_RISCV_PRIVILEGE
    select INCLUDE_RESET_VECTOR
	select BUILD_OUTPUT_HEX
    select HAS_CH32_HAL

    help
      Enable support for WCH CH58x series SoC
```

## soc/riscv/riscv-privilege/wch/Kconfig.soc
```kconfig
# Copyright (c) 2023 zerosensei
# SPDX-License-Identifier: Apache-2.0

choice
    prompt "WCH CH58X SoC implementation"
    depends on SOC_SERIES_CH58X

config SOC_CH583M
    bool "CH583M"
    select RISCV_ISA_RV32I
	select RISCV_ISA_EXT_M
	select RISCV_ISA_EXT_A
	select RISCV_ISA_EXT_C 


endchoice
```

## soc/riscv/wch/Kconfig
```kconfig
# Copyright (c) 2022 Nanjing Qinheng Microelectronics Co., Ltd.

# SPDX-License-Identifier: Apache-2.0

config SOC_FAMILY_CH32
	bool
	select BUILD_OUTPUT_HEX

if SOC_FAMILY_CH32

config SOC_FAMILY
	string
	default "wch_ch32"

source "soc/riscv/wch/*/Kconfig.soc"

endif # SOC_FAMILY_CH32
```

## soc/riscv/wch/Kconfig.defconfig
```kconfig
# SPDX-License-Identifier: Apache-2.0

source "soc/riscv/wch/*/Kconfig.defconfig.series"
```

## soc/riscv/wch/ch32v30x/Kconfig.defconfig.ch32v307_vct6
```kconfig
# ST STM32F401CC MCU configuration options

# Copyright (c) 2019 Linumiz
# SPDX-License-Identifier: Apache-2.0

if SOC_SERIES_CH32V30X

config SOC
	default	"ch32v307_vct6"

config NUM_IRQS
	default 100

endif # SOC_SERIES_CH32V30X
```

## soc/riscv/wch/ch32v30x/Kconfig.defconfig.series
```kconfig
# Copyright (c) 2021 Nanjing Qinheng Microelectronics Co., Ltd.
# SPDX-License-Identifier: Apache-2.0

if SOC_SERIES_CH32V30X

source "soc/riscv/wch/ch32v30x/Kconfig.defconfig.ch32v30*"

config SOC_SERIES
	default "ch32v30x"

endif # SOC_SERIES_CH32V30X
```

## soc/riscv/wch/ch32v30x/Kconfig.series
```kconfig
# Copyright (c) 2021 Nanjing Qinheng Microelectronics Co., Ltd.
# SPDX-License-Identifier: Apache-2.0

config SOC_SERIES_CH32V30X
	bool "CH32V30X Series MCU"
	select RISCV
	select RISCV_GP
	select DYNAMIC_INTERRUPTS
	select CLOCK_CONTROL
	select HAS_CH32_DRIVERS
	select CPU_HAS_FPU
	help
		Enable support for CH32V30X MCU series
```
