## dts/bindings/clock/wch,ch5xx-clk32k.yaml
```yaml
# Copyright (c) 2024 zerosensei
# SPDX-License-Identifier: Apache-2.0

description: WCH CH5xx 32K clock controller

compatible: "wch,ch5xx-clk32k"

include: [clock-controller.yaml, base.yaml]

properties:
  "#clock-cells":
    const: 0

  clock-source:
    required: true
    type: phandle
    description: |
      Clock source for the 32K clock.
```

## dts/bindings/clock/wch,ch5xx-lsi.yaml
```yaml
# Copyright (c) 2024 zerosensei
# SPDX-License-Identifier: Apache-2.0

description: WCH CH5xx LSI clock controller

compatible: "wch,ch5xx-lsi"

include: [clock-controller.yaml, base.yaml]

properties:
  "#clock-cells":
    const: 0
  clock-frequency:
    type: int
    enum:
     - 32000
    #  - 32768  # TODO: not support yet
```

## dts/bindings/clock/wch,ch5xx-pll.yaml
```yaml
# Copyright (c) 2024 zerosensei
# SPDX-License-Identifier: Apache-2.0

description: WCH CH5xx PLL clock controller

compatible: "wch,ch5xx-pll"

include: [clock-controller.yaml, base.yaml]

properties:
  clocks:
    required: true
```

## dts/bindings/clock/wch,ch5xx-sysclk.yaml
```yaml
# Copyright (c) 2024 zerosensei
# SPDX-License-Identifier: Apache-2.0

description: WCH CH5xx System clock clock controller

compatible: "wch,ch5xx-sysclk"

include: [clock-controller.yaml, base.yaml]

properties:
  "#clock-cells":
    const: 0
  clocks:
    required: true

  clock-frequency:
    type: int
    default: 6400000
    description: |
      System clock frequency in Hz. Supported values are:
        - 32000
        - 32768
        - DT_FREQ_M(1)
        - DT_FREQ_M(2)
        - DT_FREQ_M(4)
        - DT_FREQ_K(6400)
        - DT_FREQ_M(8)
        - DT_FREQ_M(15)
        - DT_FREQ_M(16)
        - DT_FREQ_M(20)
        - DT_FREQ_M(24)
        - DT_FREQ_M(30)
        - DT_FREQ_M(32)
        - DT_FREQ_K(36900)
        - DT_FREQ_M(40)
        - DT_FREQ_M(48)
        - DT_FREQ_M(60)
        - DT_FREQ_M(80)
    enum:
      - 32000
      - 32768
      - 1000000
      - 2000000
      - 4000000
      - 6400000
      - 8000000
      - 15000000
      - 16000000
      - 20000000
      - 24000000
      - 30000000
      - 32000000
      - 36900000
      - 40000000
      - 48000000
      - 60000000
      - 80000000
```

## dts/bindings/cpu/wch,riscv.yaml
```yaml
# Copyright (c) 2021 Nanjing Qinheng Microelectronics Co., Ltd.
# SPDX-License-Identifier: Apache-2.0

description: WCH RISC-V CPU

compatible: "wch,riscv"

include: cpu.yaml

properties:
    clock-source:
      type: int
      description: cpu clock source
      required: false
```

## dts/bindings/flash_controller/wch,ch5xx-flash-controller.yaml
```yaml
# Copyright (c) 2024 zerosensei
# SPDX-License-Identifier: Apache-2.0
description: WCH CH5XX flash controller

compatible: "wch,ch5xx-flash-controller"

include: flash-controller.yaml

properties:
  "#erase-block-cells":
    type: int
    const: 2

  data-flash-offset:
    type: int
    required: true
    
erase-block-cells:
  - pages-count
  - pages-size
```

## dts/bindings/flash_controller/wch,ch5xx-flash.yaml
```yaml
# Copyright (c) 2024 zerosensei
# SPDX-License-Identifier: Apache-2.0
description: WCH CH5XX flash

compatible: "wch,ch5xx-flash"

include: base.yaml

properties:
  write-block-size:
    type: int
    description: |
      The flash controller is limited by hardware to writing blocks of
      this size, aligned to this size, in bytes, to previously erased
      flash, within the flash memory area.

  erase-block-size:
    type: int
    description: |
      The flash controller is limited by hardware to erase whole
      blocks of flash at a time. This property describes the largest
      erase block size in erase-blocks.

  erase-blocks:
    type: phandle-array
    required: true
    description: |
      The flash controller is limited by hardware to erase whole
      blocks of flash at a time. This property describes the layout of
      the erase-blocks, which can vary in size within the flash memory
      area.
```

## dts/bindings/flash_controller/wch,whc-flash_controller.yaml
```yaml
# Copyright (c) 2021 Nanjing Qinheng Microelectronics Co., Ltd.
# SPDX-License-Identifier: Apache-2.0

description: WCH Family flash controller

compatible: "wch,wch-flash-controller"

include: flash-controller.yaml
```

## dts/bindings/gpio/wch,ch32-gpio.yaml
```yaml
# Copyright (c) 2021 Nanjing Qinheng Microelectronics Co., Ltd.
# SPDX-License-Identifier: Apache-2.0

description: CH32 GPIO node

compatible: "wch,ch32-gpio"

include: [gpio-controller.yaml, base.yaml]

properties:
    reg:
      required: true

    label:
      required: true

    clocks:
      required: true

    "#gpio-cells":
      const: 2

gpio-cells:
  - pin
  - flags
```

## dts/bindings/gpio/wch,ch5xx-gpio.yaml
```yaml
# Copyright (c) 2024 zerosensei
# SPDX-License-Identifier: Apache-2.0

description: WCH GPIO node

compatible: "wch,ch5xx-gpio"

include: [gpio-controller.yaml, base.yaml]

properties:
  reg:
    required: true

  "#gpio-cells":
    const: 2

gpio-cells:
  - pin
  - flags
```

## dts/bindings/i2c/wch,ch32-i2c.yaml
```yaml
# Copyright (c) 2021 Nanjing Qinheng Microelectronics Co., Ltd.
# SPDX-License-Identifier: Apache-2.0

description: CH32 I2C V1 controller

compatible: "wch,ch32-i2c-v1"

include: [i2c-controller.yaml, pinctrl-device.yaml]

properties:
    reg:
      required: true

    interrupts:
      required: true

    pinctrl-0:
      required: true

    pinctrl-names:
      required: true
```

## dts/bindings/interrupt-controller/riscv,plic0.yaml
```yaml
# Copyright (c) 2021 Nanjing Qinheng Microelectronics Co., Ltd.

# SPDX-License-Identifier: Apache-2.0

# Common fields for the RISC-V platform-local interrupt controller

include: [interrupt-controller.yaml, base.yaml]

properties:
  reg:
    required: true

  riscv,max-priority:
    type: int
    description: maximum interrupt priority
    required: true

  "#interrupt-cells":
    const: 2

interrupt-cells:
  - irq
  - priority
```

## dts/bindings/interrupt-controller/wch,ch32-exti.yaml
```yaml
# Copyright (c) 2021 Nanjing Qinheng Microelectronics Co., Ltd.
# SPDX-License-Identifier: Apache-2.0

description: CH32 family External Interrupt Controller

compatible: "wc,ch32-exti"

include: base.yaml

properties:
  reg:
    required: true
```

## dts/bindings/interrupt-controller/wch,pfic.yaml
```yaml
# Copyright (c) 2024 zerosensei

# SPDX-License-Identifier: Apache-2.0

# Common fields for the RISC-V platform-local interrupt controller

description:  WCH RISC-V interrupt controller

compatible: "wch,pfic"

include: [interrupt-controller.yaml, base.yaml]

properties:
  reg:
    required: true

  "#interrupt-cells":
    const: 2

interrupt-cells:
  - irq
  - priority
```

## dts/bindings/interrupt-controller/wch,plic0.yaml
```yaml
# Copyright (c) 2021 Nanjing Qinheng Microelectronics Co., Ltd.

# SPDX-License-Identifier: Apache-2.0

# Common fields for the RISC-V platform-local interrupt controller

description:  CH32 RISCV-V interrupt controller

compatible: "wch,plic0"

include: [interrupt-controller.yaml, base.yaml]

properties:
  reg:
      required: true

  riscv,max-priority:
      type: int
      description: maximum interrupt priority
      required: true

  "#interrupt-cells":
      const: 2

interrupt-cells:
  - irq
  - priority
```

## dts/bindings/pinctrl/wch,ch5xx-pinctrl.yaml
```yaml
# Copyright (c) 2024 zerosensei
# SPDX-License-Identifier: Apache-2.0

description: WCH pin controller

compatible: "wch,ch5xx-pinctrl"

include: base.yaml

child-binding:
  description: CH5xx pinmux group

  child-binding:
    include:
      - name: pincfg-node.yaml
        property-allowlist:
          - bias-pull-up
          - bias-pull-down
          - drive-push-pull
          - drive-open-drain
          - input-enable
          - output-enable

    properties:
      pinmux:
        required: true
        type: array

      gpio-flags:
        type: int
        description: Additional flags for the pin.
```

## dts/bindings/pwm/wch,ch32-pwm.yaml
```yaml
description: CH32 PWM

compatible: "wch,ch32-pwm"

include: [pwm-controller.yaml, base.yaml, pinctrl-device.yaml]

properties:
    label:
      required: true

    pinctrl-0:
      required: true

    pinctrl-names:
      required: true

    st,prescaler:
      type: int
      required: false
      deprecated: true
      description: |
        Clock prescaler at the input of the timer

    "#pwm-cells":
      const: 3

pwm-cells:
  - channel
# period in terms of nanoseconds
  - period
  - flags
```

## dts/bindings/rng/wch,ch32-rng.yaml
```yaml
# Copyright (c) 2021 Nanjing Qinheng Microelectronics Co., Ltd.
# SPDX-License-Identifier: Apache-2.0

description: WCH family RNG (Random Number Generator)

compatible: "wch,whc-rng"

include: base.yaml

properties:
    reg:
      required: true

    interrupts:
      required: true
```

## dts/bindings/rtc/wch,ch5xx-rtc.yaml
```yaml
# Copyright (c) 2024 zerosensei
# SPDX-License-Identifier: Apache-2.0

description: WCH RTC (Real-Time Counter)

compatible: "wch,wch-rtc"

include: rtc.yaml

properties:
  reg:
    required: true
    
# TODO:
  clk-source:
    type: int
    enum:
     - 0
     - 1
     - 2
    description: |
      0: LSE 32768Hz, 1: LSI 32000Hz, 2: LSI 32768Hz
      
```

## dts/bindings/serial/wch,ch32-uart.yaml
```yaml
description: CH32 UART

compatible: "wch,ch32-uart"

include: wch,ch32-uart-common.yaml
```

## dts/bindings/serial/wch,ch32-usart.yaml
```yaml
description: CH32 USART

compatible: "wch,ch32-usart"

include: wch,ch32-uart-common.yaml
```

## dts/bindings/spi/wch,ch32-spi.yaml
```yaml
description: CH32 SPI controller

compatible: "wch,ch32-spi"

include: [spi-controller.yaml, pinctrl-device.yaml]

properties:
    reg:
      required: true

    interrupts:
      required: true

    pinctrl-0:
      required: true

    pinctrl-names:
      required: true
```

## dts/bindings/timer/wch,ch32-systimer.yaml
```yaml
# Copyright (c) 2021 Espressif Systems (Shanghai) Co., Ltd.
# SPDX-License-Identifier: Apache-2.0

description: CH32 Systimer peripheral

compatible: "wch,ch32-systimer"

include: base.yaml

properties:
    reg:
      required: true

    interrupts:
      required: true

    label:
      required: true
```

## dts/bindings/timer/wch,ch32-timers.yaml
```yaml
description: CH32 timers

compatible: "wch,ch32-timers"

include: base.yaml

properties:
    label:
      required: true

    reg:
      required: true

    clocks:
      required: true

    interrupts:
      required: false

    st,prescaler:
      type: int
      required: true
      description: |
        Clock prescaler at the input of the timer
        Could be in range [0 .. 0xFFFF] for CH32 General Purpose Timers (CLK/(prescaler+1) )
```

## dts/bindings/timer/wch,systimer.yaml
```yaml
# Copyright (c) 2024 zerosensei

# SPDX-License-Identifier: Apache-2.0

description: WCH System Timer

compatible: "wch,systimer"

include: base.yaml

properties:
  reg:
    required: true

  interrupts:
    required: true
```
