## soc/riscv/wch/ch32v30x/Kconfig.soc
```kconfig
# Copyright (c) 2021 Nanjing Qinheng Microelectronics Co., Ltd.
# SPDX-License-Identifier: Apache-2.0

choice 
	prompt "CH32V30x MCU Selection"
	depends on SOC_CH32V30X

config SOC_CH32V303x
	bool "CH32V303x"

config SOC_CH32V305
	bool "CH32V305"

config SOC_CH32V307
	bool "CH32V307"

endchoice
```

## soc/wch/Kconfig
```kconfig
# Copyright (c) 2024 zerosensei
# SPDX-License-Identifier: Apache-2.0

config SOC_FAMILY_WCH
    select xxx  # TODO:

if SOC_FAMILY_WCH

rsource "*/Kconfig"

endif # SOC_FAMILY_WCH
```

## soc/wch/Kconfig.defconfig
```kconfig
# Copyright (c) 2024 zerosensei
# SPDX-License-Identifier: Apache-2.0

if SOC_FAMILY_WCH

rsource "*/Kconfig.defconfig"


endif # SOC_FAMILY_WCH
```

## soc/wch/Kconfig.soc
```kconfig
# Copyright (c) 2024 zerosensei
# SPDX-License-Identifier: Apache-2.0

config SOC_SERIES
	default "ch57x" if SOC_SERIES_CH57X
	default "ch58x" if SOC_SERIES_CH58X
	default "ch59x" if SOC_SERIES_CH59X
	default "ch32" if SOC_SERIES_CH32

config SOC_FAMILY_WCH
	bool

config SOC_FAMILY
	default "wch" if SOC_FAMILY_WCH

config SOC_SERIES_CH57X
	bool
	select SOC_FAMILY_WCH
	help
	  Enable support for CH57X MCU series

config SOC_SERIES_CH58X
	bool
	select SOC_FAMILY_WCH
	help
	  Enable support for CH58X MCU series

config SOC_SERIES_CH59X
	bool
	select SOC_FAMILY_WCH
	help
	  Enable support for CH59X MCU series

config SOC_SERIES_CH32
	bool
	select SOC_FAMILY_WCH
	help
	  Enable support for CH32 MCU series

rsource "*/Kconfig.soc"
```

## soc/wch/ch58x/Kconfig
```kconfig
# Copyright (c) 2024 zerosensei
# SPDX-License-Identifier: Apache-2.0

config SOC_SERIES_CH58X
    select RISCV
	select ARCH_HAS_RAMFUNC_SUPPORT
	select RISCV_ISA_RV32I
	select RISCV_ISA_EXT_M
	select RISCV_ISA_EXT_A
	select RISCV_ISA_EXT_C
	select RISCV_ISA_EXT_ZICSR
	select ATOMIC_OPERATIONS_C
    select INCLUDE_RESET_VECTOR
    select ARCH_HAS_CUSTOM_CPU_IDLE
    select ARCH_HAS_CUSTOM_CPU_ATOMIC_IDLE
	select HAS_PM
	select HAS_CH58X_HAL
    imply XIP
```

## soc/wch/ch58x/Kconfig.defconfig
```kconfig
# Copyright (c) 2024 zerosensei
# SPDX-License-Identifier: Apache-2.0

if SOC_SERIES_CH58X

rsource "Kconfig.defconfig.ch58*"

DT_CLK32K_PATH := $(dt_nodelabel_path,clk32k)
DT_CLOCK_SRC_PATH := $(dt_node_ph_prop_path,$(DT_CLK32K_PATH),clock-source)

config SYS_CLOCK_TICKS_PER_SEC
    default $(dt_node_int_prop_int,$(DT_CLOCK_SRC_PATH),clock-frequency) \
        if WCH_RTC_TIMER
    default 1000

config SYS_CLOCK_HW_CYCLES_PER_SEC
    default $(dt_node_int_prop_int,$(DT_CLOCK_SRC_PATH),clock-frequency) \
         if WCH_RTC_TIMER
	default $(dt_node_int_prop_int,/clocks/sysclk,clock-frequency)

if RISCV_PMP
config PMP_SLOTS
	default 4
endif # PMP_SLOTS

config RISCV_GP
	default y

config CLOCK_CONTROL
	default y

endif # SOC_SERIES_CH58X
```

## soc/wch/ch58x/Kconfig.defconfig.ch581f
```kconfig
# Copyright (c) 2024 zerosensei
# SPDX-License-Identifier: Apache-2.0

if SOC_CH581F

config NUM_IRQS
	default 36

endif # SOC_CH581F
```

## soc/wch/ch58x/Kconfig.defconfig.ch582f
```kconfig
# Copyright (c) 2024 zerosensei
# SPDX-License-Identifier: Apache-2.0

if SOC_CH582F

config NUM_IRQS
	default 36

endif # SOC_CH582F
```

## soc/wch/ch58x/Kconfig.defconfig.ch582m
```kconfig
# Copyright (c) 2024 zerosensei
# SPDX-License-Identifier: Apache-2.0

if SOC_CH582M

config NUM_IRQS
	default 36

endif # SOC_CH582
```

## soc/wch/ch58x/Kconfig.defconfig.ch583m
```kconfig
# Copyright (c) 2024 zerosensei
# SPDX-License-Identifier: Apache-2.0

if SOC_CH583M

config NUM_IRQS
	default 36

endif # SOC_CH583
```

## soc/wch/ch58x/Kconfig.soc
```kconfig
# Copyright (c) 2024 zerosensei
# SPDX-License-Identifier: Apache-2.0

config SOC_CH581
    bool
    select SOC_SERIES_CH58X

config SOC_CH582
    bool
    select SOC_SERIES_CH58X

config SOC_CH583
    bool
    select SOC_SERIES_CH58X

config SOC_CH581F
    bool
    select SOC_CH581

config SOC_CH582M
    bool 
    select SOC_CH582

config SOC_CH582F
    bool 
    select SOC_CH582

config SOC_CH583M
    bool
    select SOC_CH583

config SOC
    default "ch581" if SOC_CH581F
    default "ch582" if SOC_CH582M || SOC_CH582F
    default "ch583" if SOC_CH583M
```
