## boards/riscv/CH32V307_VCT6/Kconfig.board
```kconfig
# Copyright (c) 2021 Nanjing Qinheng Microelectronics Co., Ltd.
# SPDX-License-Identifier: Apache-2.0


config BOARD_CH32V307_VCT6
	bool "CH32V307 VCT6 Board"
	depends on SOC_CH32V307
```

## boards/riscv/CH32V307_VCT6/Kconfig.defconfig
```kconfig
# Copyright (c) 2021 Nanjing Qinheng Microelectronics Co., Ltd.
# SPDX-License-Identifier: Apache-2.0

if BOARD_CH32V307_VCT6

config BOARD
	default "ch32v307_vct6"

endif # BOARD_CH32V307_VCT6
```

## boards/riscv/ch32v307v_r1/Kconfig.defconfig
```kconfig
# Copyright (c) 2021 Nanjing Qinheng Microelectronics Co., Ltd.
# SPDX-License-Identifier: Apache-2.0

if BOARD_CH32V307V_R1

config BOARD
	default "ch32v307v_r1"

endif # BOARD_CH32V307V_R1
```

## boards/riscv/ch32v307v_r1/ch32v307v_r1_defconfig
```kconfig
# Copyright (c) 2022 zerosensei
# SPDX-License-Identifier: Apache-2.0

CONFIG_SOC_SERIES_CH32V=y
CONFIG_SOC_CH32V307_VCT6=y
CONFIG_BOARD_CH32V307V_R1=y
CONFIG_SYS_CLOCK_HW_CYCLES_PER_SEC=72000000
# enable uart driver
CONFIG_SERIAL=y
# enable console
CONFIG_CONSOLE=y
CONFIG_UART_CONSOLE=y

# enable GPIO
CONFIG_GPIO=y

# enable clocks
CONFIG_CLOCK_CONTROL=y

# enable pin controller
CONFIG_PINCTRL=y

CONFIG_PINMUX=y

# CONFIG_ASSERT=y

# CONFIG_PRINTK=y
```

## boards/wch/ch582m-r0-1v0/Kconfig.ch582m-r0-1v0
```kconfig
# ESP32C3 devkitm board configuration

# Copyright (c) 2021 Espressif Systems (Shanghai) Co., Ltd.
# SPDX-License-Identifier: Apache-2.0

config BOARD_CH582M_R0_1V0
	select SOC_CH582M
```

## boards/wch/ch582m-r0-1v0/Kconfig.defconfig
```kconfig
# Copyright (c) 2024 zerosensei
# SPDX-License-Identifier: Apache-2.0

if BOARD_CH582M_R0_1V0

# config USB_DEVICE_STACK
#     default y

config CONSOLE
    default y

config UART_CONSOLE
    default CONSOLE



if USB_DEVICE_STACK

config SERIAL
    default y

endif # USB_DEVICE_STACK

if BT
config BT_CTLR
    default n

config BT_CTLR_CRYPTO
    default n

choice BT_HCI_BUS_TYPE
	default BT_WCH
endchoice

endif # BT

# config HEAP_MEM_POOL_ADD_SIZE_BOARD
# 	int
# 	default 100 if BT
# 	default 0

endif # BOARD_CH582M_R0_1V0
```

## boards/wch/ch582m-r0-1v0/ch582m-r0-1v0_defconfig
```kconfig
# Copyright (c) 2024 zerosensei
# SPDX-License-Identifier: Apache-2.0

CONFIG_GPIO=y

# Enable UART
CONFIG_SERIAL=y

# enable console
CONFIG_CONSOLE=y
CONFIG_UART_CONSOLE=y

CONFIG_BUILD_OUTPUT_HEX=y
CONFIG_OUTPUT_DISASSEMBLY=y

# TODO: TEST
CONFIG_TEST_RANDOM_GENERATOR=y
CONFIG_TIMER_RANDOM_GENERATOR=y
```

## boards/wch/ch583m_evt/Kconfig.ch583m_evt
```kconfig
# Copyright (c) 2024 zerosensei
# SPDX-License-Identifier: Apache-2.0

config BOARD_CH583M_EVT
    bool "WCH CH583M EVT board"
    select SOC_CH583M
```

## boards/wch/ch583m_evt/Kconfig.defconfig
```kconfig
# Copyright (c) 2024 zerosensei
# SPDX-License-Identifier: Apache-2.0

if BOARD_CH583M_EVT

config CONSOLE
    default y

config UART_CONSOLE
    default CONSOLE

if USB_DEVICE_STACK
config SERIAL
    default y
endif # USB_DEVICE_STACK

if BT
config BT_CTLR
    default n

config BT_CTLR_CRYPTO
    default n

config BT_WCH
    default y

endif # BT

# config HEAP_MEM_POOL_ADD_SIZE_BOARD
# 	int
# 	default 100 if BT
# 	default 0

endif # BOARD_CH583M_EVT
```

## boards/xtensa/esp32s3_usbotg/Kconfig.defconfig
```kconfig
# ESP32S3 DevKitM board configuration

# Copyright (c) 2022 Espressif Systems (Shanghai) Co., Ltd.
# SPDX-License-Identifier: Apache-2.0

if BOARD_ESP32S3_USBOTG

config BOARD
	default "esp32s3_usbotg"

config HEAP_MEM_POOL_SIZE
	default 98304 if WIFI
	default 40960 if BT
	default 4096

choice BT_HCI_BUS_TYPE
	default BT_ESP32 if BT
endchoice

endif

if BOARD_ESP32S3_USBOTG_APPCPU

config BOARD
	default "esp32s3_usbotg_appcpu"

config HEAP_MEM_POOL_SIZE
	default 4096

config KERNEL_BIN_NAME
	default "esp32_net_firmware"
endif

config ENTROPY_GENERATOR
	default y

if LVGL

config LV_Z_BITS_PER_PIXEL
	default 16 

choice LV_COLOR_DEPTH
	default LV_COLOR_DEPTH_16
endchoice

config LV_COLOR_16_SWAP
	default y

endif # LVGL
```

## drivers/clock_control/Kconfig.ch32
```kconfig
# CH32 MCU clock control driver config

# Copyright (c) 2022 Nanjing Qinheng Microelectronics Co., Ltd.

# SPDX-License-Identifier: Apache-2.0


menuconfig CLOCK_CONTROL_CH32
	bool "CH32 Reset & Clock Control"
	# depends on SOC_FAMILY_CH32
	help
	  Enable driver for Reset & Clock Control subsystem found
	  in CH32 family of MCUs

if CLOCK_CONTROL_CH32

DT_CH32_HSE_CLOCK := $(dt_nodelabel_path,clk_hse)
DT_CH32_HSE_CLOCK_FREQ := $(dt_node_int_prop_int,$(DT_CH32_HSE_CLOCK),clock-frequency)

config CLOCK_CH32_HSE_CLOCK
	int "HSE clock value"
	default "$(DT_CH32_HSE_CLOCK_FREQ)" if "$(dt_nodelabel_enabled,clk_hse)"
	default 8000000
	help
	  Value of external high-speed clock (HSE). This symbol could be optionally
	  configured using device tree by setting "clock-frequency" value of clk_hse
	  node. For instance:
	  &clk_hse{
	  status = "okay";
	  clock-frequency = <DT_FREQ_M(25)>;
	  };
	  Note: Device tree configuration is overridden when current symbol is set:
	  CONFIG_CLOCK_CH32_HSE_CLOCK=32000000

# Micro-controller Clock output configuration options

choice
	prompt "CH32 MCO Clock Source"
	default CLOCK_CH32_MCO_SRC_NOCLOCK

config CLOCK_CH32_MCO_SRC_NOCLOCK
	bool "NOCLOCK"
	help
	  MCO output disabled, no clock on MCO

config CLOCK_CH32_MCO_SRC_SYSCLK
	bool "SYSCLK"
	depends on SOC_CH32V30X
	help
	  Use SYSCLK as source of MCO

config CLOCK_CH32_MCO_SRC_HSI
	bool "HSI"
	depends on SOC_CH32V30X
	help
	  Use HSI as source of MCO

config CLOCK_CH32_MCO_SRC_HSE
	bool "HSE"
	depends on SOC_CH32V30X
	help
	  Use HSE as source of MCO

config CLOCK_CH32_MCO_SRC_PLL_DIV2
	bool "PLL DIV2"
	depends on SOC_CH32V30X
	help
	  Use PLL as source of MCO, division 2

config CLOCK_CH32_MCO_SRC_PLL2
	bool "PLL2"
	depends on SOC_CH32V30X
	help
	  Use PLL2 as source of MCO

config CLOCK_CH32_MCO_SRC_PLL3_DIV2
	bool "PLL3 DIV2"
	depends on SOC_CH32V30X
	help
	  Use PLL3 as source of MCO, division 2

config CLOCK_CH32_MCO_SRC_XT1
	bool "XI1"
	depends on SOC_CH32V30X
	help
	  Use XI1 as source of MCO

config CLOCK_CH32_MCO_SRC_PLL3
	bool "PLL3"
	depends on SOC_CH32V30X
	help
	  Use PLL3 as source of MCO

endchoice

endif # CLOCK_CONTROL_CH32
```

## drivers/clock_control/Kconfig.ch32v
```kconfig
# Copyright (c) 2024 zerosensei
# SPDX-License-Identifier: Apache-2.0

config CLOCK_CONTROL_CH58X
	bool "WCH CH58x Systime clock controller"
	default y
	depends on DT_HAS_WCH_CH5XX_SYSCLK_ENABLED
	help
	  Enable WCH CH58x clock controller.
```

## drivers/flash/Kconfig.ch5xx
```kconfig
# SPDX-License-Identifier: Apache-2.0

config SOC_FLASH_CH5XX
	bool "WCH CH5XX flash driver"
	default y
	depends on DT_HAS_WCH_CH5XX_FLASH_CONTROLLER_ENABLED
	select FLASH_HAS_DRIVER_ENABLED
	select FLASH_HAS_PAGE_LAYOUT
    select FLASH_HAS_EXPLICIT_ERASE
	help
	  Enable WCH flash driver.
```

## drivers/gpio/Kconfig.ch32
```kconfig
# STM32 GPIO configuration

# Copyright (c) 2016 Open-RnD Sp. z o.o.
# SPDX-License-Identifier: Apache-2.0

config GPIO_CH32
	bool "GPIO Driver for CH32 family of MCUs"
	# depends on SOC_FAMILY_CH32
	help
	  Enable GPIO driver for CH32 line of MCUs
```

## drivers/gpio/Kconfig.ch5xx
```kconfig
# Copyright (c) 2024 zerosensei
# SPDX-License-Identifier: Apache-2.0

config GPIO_CH5XX
	bool "WCH CH5XX GPIO driver"
	default y
	depends on DT_HAS_WCH_CH5XX_GPIO_ENABLED
	help
	  Enable the GPIO driver on TI SimpleLink CC32xx boards
```

## drivers/pinctrl/Kconfig.ch32
```kconfig
# Copyright (c) 2022 zerosensei
# SPDX-License-Identifier: Apache-2.0

config PINCTRL_CH32
	bool "Pin controller driver for CH32 MCUs"
	# depends on SOC_FAMILY_CH32
	default y
	help
	  Enable pin controller driver for CH32 MCUs

config PINCTRL_CH32_REMAP_INIT_PRIORITY
	int "Remap initialization priority"
	default 2
	help
	  Initialization priority for the routine in charge of configuring the
	  remap for pins PA11/12.
```

## drivers/pinctrl/Kconfig.ch5xx
```kconfig
# Copyright (c) 2024 zerosensei
# SPDX-License-Identifier: Apache-2.0


config PINCTRL_CH5XX
	bool "WCH CH5xx pinctrl driver"
	default y
	depends on DT_HAS_WCH_CH5XX_PINCTRL_ENABLED
	help
	  Enable the WCH CH5xx pinctrl driver
```

## drivers/serial/Kconfig.ch32
```kconfig
# Copyright (c) 2021 ATL Electronics
# SPDX-License-Identifier: Apache-2.0

DT_COMPAT_CH32_USART := wch,ch32-usart

config UART_CH32
	bool "CH32 serial driver"
	default $(dt_compat_enabled,$(DT_COMPAT_CH32_USART))
	depends on SOC_SERIES_CH32V
	select SERIAL_HAS_DRIVER
	select GPIO_CH32
	# select SERIAL_SUPPORT_INTERRUPT
	help
	  This option enables the USART driver for CH32 SoC family.
```

## drivers/timer/Kconfig.ch32_rtc
```kconfig
# STM32 LPTIM configuration options

# Copyright (c) 2019 STMicroelectronics
# SPDX-License-Identifier: Apache-2.0

menuconfig CH32_RTC_TIMER
	bool "CH32 Real Time Counter Timer"
	depends on CLOCK_CONTROL
	select TICKLESS_CAPABLE
	help
	  This module implements a kernel device driver for the Real Time
	  Counter and provides the standard "system clock driver"
	  interfaces.

if CH32_RTC_TIMER

choice CH32_RTC_CLOCK
	prompt "LPTIM clock value configuration"

config CH32_RTC_CLOCK_LSI
	bool "LSI"
	help
	  Use LSI as RTC clock

config CH32_RTC_CLOCK_LSE
	bool "LSE"
	help
	  Use LSE as RTC clock

endchoice

config CH32_RTC_CLOCK
	int "LPTIM clock value"
	default 32768 if CH32_RTC_CLOCK_LSE
	default 32000 if CH32_RTC_CLOCK_LSI

endif # CH32_RTC_TIMER
```

## drivers/timer/Kconfig.wch
```kconfig
# Copyright (c) 2024 zerosensei
# SPDX-License-Identifier: Apache-2.0

choice
    prompt "WCH System clock source"
    default WCH_RTC_TIMER

config WCH_RTC_TIMER
	bool "WCH Real Time Counter Timer"
	depends on CLOCK_CONTROL
	select TICKLESS_CAPABLE
	select SYSTEM_TIMER_HAS_DISABLE_SUPPORT
	depends on $(dt_nodelabel_enabled,clk32k)
	help
	  This module implements a kernel device driver for the WCH Real Time
	  Counter and provides the standard "system clock driver" interfaces.

config WCH_SYS_TIMER
	bool "WCH System Timer"
	depends on CLOCK_CONTROL
	select TICKLESS_CAPABLE
	select SYSTEM_TIMER_HAS_DISABLE_SUPPORT
	select TIMER_HAS_64BIT_CYCLE_COUNTER
	depends on $(dt_nodelabel_enabled,systimer)
	help
	  This module implements a kernel device driver for the system timer
	  and provides the standard "system clock driver" interfaces.


endchoice
```

## drivers/timer/Kconfig.wch_rtc
```kconfig
# Copyright (c) 2024 zerosensei
# SPDX-License-Identifier: Apache-2.0

config WCH_RTC_TIMER
	bool "WCH Real Time Counter Timer"
	depends on CLOCK_CONTROL
	select TICKLESS_CAPABLE
	select SYSTEM_TIMER_HAS_DISABLE_SUPPORT
	depends on !$(dt_nodelabel_enabled,rtc1)
	help
	  This module implements a kernel device driver for the WCH Real Time
	  Counter and provides the standard "system clock driver" interfaces.

if WCH_RTC_TIMER

choice WCH_RTC_SOURCE
    prompt "WCH RTC source select"
    default WCH_RTC_LSI_32000

config WCH_RTC_LSI_32000
    bool "LSI 32000Hz"
    help
      Use LSI 32000Hz
    
config WCH_RTC_LSI_32768
    bool "LSI 32768Hz"
    help
      Use LSI 32768Hz

config WCH_RTC_LSE_32768
    bool "LSE 32768Hz"
    help
      Use LSE 32768Hz

endchoice

# TODO:

endif # WCH_RTC_TIMER
```

## dts/bindings/adc/wch,ch32-adc.yaml
```yaml
# Copyright (c) 2021 Nanjing Qinheng Microelectronics Co., Ltd.
# SPDX-License-Identifier: Apache-2.0

description: WCH CH32 family ADC

compatible: "wch,ch32-adc"

include: [adc-controller.yaml, pinctrl-device.yaml]

properties:
    reg:
      required: true

    clocks:
      required: true

    interrupts:
      required: true

    "#io-channel-cells":
      const: 1

    pinctrl-0:
      required: true

    pinctrl-names:
      required: true

io-channel-cells:
    - input
```

## dts/bindings/clock/wch,ch32-hse-clock.yaml
```yaml
# Copyright (c) 2021 Nanjing Qinheng Microelectronics Co., Ltd.
# SPDX-License-Identifier: Apache-2.0

description: CH32 HSE Clock

compatible: "wch,ch32-hse-clock"

include: [fixed-clock.yaml]

properties:
    hse-bypass:
      type: boolean
      required: false
      description: |
        HSE crystal oscillator bypass
        Set to the property to by-pass the oscillator with an external clock.
```

## dts/bindings/clock/wch,ch32v30-rcc.yaml
```yaml
# Copyright (c) 2021 Nanjing Qinheng Microelectronics Co., Ltd.
# SPDX-License-Identifier: Apache-2.0

description: |
  CH32 Reset and Clock controller node.
  For more description confere wch,ch32-rcc.yaml

compatible: "wch,ch32v30-rcc"

include:
  - name: wch,ch32-rcc.yaml
    property-blocklist:
      - apb2-prescaler
```
