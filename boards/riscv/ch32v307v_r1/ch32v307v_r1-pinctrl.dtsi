/*
 * NOTE: Autogenerated file using genpinctrl.py
 *
 * SPDX-License-Identifier: Apache-2.0
 */

 #include <dt-bindings/pinctrl/ch32-pinctrl.h>

 &pinctrl {
	usart0_default: usart0_default {
		group1 {
			pinmux = <USART0_RX_PA10_NORMP>, <USART0_TX_PA9_NORMP>;
		};
	};

};